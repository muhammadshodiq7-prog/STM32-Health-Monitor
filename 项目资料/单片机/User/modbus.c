#include "modbus.h"
#include "usart.h"
#include <string.h>

// Modbus响应缓冲区
uint8_t modbus_tx_buffer[256];
uint16_t response_data[256];

// CRC16查找表
static const uint8_t auchCRCHi[] = {
    0x00, 0xC1, 0x81, 0x40, 0x01, 0xC0, 0x80, 0x41, 0x01, 0xC0, 0x80, 0x41,
    0x00, 0xC1, 0x81, 0x40, 0x01, 0xC0, 0x80, 0x41, 0x00, 0xC1, 0x81, 0x40,
    0x00, 0xC1, 0x81, 0x40, 0x01, 0xC0, 0x80, 0x41, 0x01, 0xC0, 0x80, 0x41,
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    0x00, 0xC1, 0x81, 0x40
};

static const uint8_t auchCRCLo[] = {
    0x00, 0xC0, 0xC1, 0x01, 0xC3, 0x03, 0x02, 0xC2, 0xC6, 0x06, 0x07, 0xC7,
    0x05, 0xC5, 0xC4, 0x04, 0xCC, 0x0C, 0x0D, 0xCD, 0x0F, 0xCF, 0xCE, 0x0E,
    0x0A, 0xCA, 0xCB, 0x0B, 0xC9, 0x09, 0x08, 0xC8, 0xD8, 0x18, 0x19, 0xD9,
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    0x41, 0x81, 0x80, 0x40
};

// CRC16计算
uint16_t Modbus_CRC16(uint8_t *data, uint16_t length)
{
    uint8_t uchCRCHi = 0xFF;
    uint8_t uchCRCLo = 0xFF;
    uint16_t uIndex;

    while(length--)
    {
        uIndex = uchCRCHi ^ *data++;
        uchCRCHi = uchCRCLo ^ auchCRCHi[uIndex];
        uchCRCLo = auchCRCLo[uIndex];
    }

    return (uchCRCHi << 8 | uchCRCLo);
}

// 发送Modbus响应
void Modbus_Send_Response(uint8_t *buffer, uint16_t length)
{
    // 计算CRC并添加到帧尾
    uint16_t crc = Modbus_CRC16(buffer, length);
    buffer[length] = crc & 0xFF;
    buffer[length + 1] = (crc >> 8) & 0xFF;

    // 发送完整帧
    for(uint16_t i = 0; i < length + 2; i++)
    {
        USART1_SendByte(buffer[i]);
    }
}

// 处理读输入寄存器（功能码0x04）
void Modbus_Read_Input_Registers(uint8_t *rx_buffer, uint16_t *input_registers)
{
    uint16_t start_address = (rx_buffer[2] << 8) | rx_buffer[3];
    uint16_t quantity = (rx_buffer[4] << 8) | rx_buffer[5];

    // 限制读取数量
    if(quantity > 125) quantity = 125;

    // 构建响应
    modbus_tx_buffer[0] = 1;  // 从站地址
    modbus_tx_buffer[1] = 0x04;  // 功能码
    modbus_tx_buffer[2] = quantity * 2;  // 字节数

    uint16_t index = 3;
    for(uint16_t i = 0; i < quantity; i++)
    {
        uint16_t reg_value = input_registers[start_address + i];
        modbus_tx_buffer[index++] = reg_value >> 8;
        modbus_tx_buffer[index++] = reg_value & 0xFF;
    }

    Modbus_Send_Response(modbus_tx_buffer, index);
}

// 处理读保持寄存器（功能码0x03）
void Modbus_Read_Holding_Registers(uint8_t *rx_buffer, uint16_t *holding_registers)
{
    uint16_t start_address = (rx_buffer[2] << 8) | rx_buffer[3];
    uint16_t quantity = (rx_buffer[4] << 8) | rx_buffer[5];

    // 限制读取数量
    if(quantity > 125) quantity = 125;

    // 构建响应
    modbus_tx_buffer[0] = 1;  // 从站地址
    modbus_tx_buffer[1] = 0x03;  // 功能码
    modbus_tx_buffer[2] = quantity * 2;  // 字节数

    uint16_t index = 3;
    for(uint16_t i = 0; i < quantity; i++)
    {
        uint16_t reg_value = holding_registers[start_address + i];
        modbus_tx_buffer[index++] = reg_value >> 8;
        modbus_tx_buffer[index++] = reg_value & 0xFF;
    }

    Modbus_Send_Response(modbus_tx_buffer, index);
}

// 处理写单个保持寄存器（功能码0x06）
void Modbus_Write_Single_Register(uint8_t *rx_buffer, uint16_t *holding_registers)
{
    uint16_t address = (rx_buffer[2] << 8) | rx_buffer[3];
    uint16_t value = (rx_buffer[4] << 8) | rx_buffer[5];

    // 写入寄存器
    holding_registers[address] = value;

    // 回显响应
    memcpy(modbus_tx_buffer, rx_buffer, 6);
    Modbus_Send_Response(modbus_tx_buffer, 6);
}

// 处理写多个保持寄存器（功能码0x10）
void Modbus_Write_Multiple_Registers(uint8_t *rx_buffer, uint16_t *holding_registers)
{
    uint16_t start_address = (rx_buffer[2] << 8) | rx_buffer[3];
    uint16_t quantity = (rx_buffer[4] << 8) | rx_buffer[5];
    uint8_t byte_count = rx_buffer[6];

    // 写入寄存器
    for(uint16_t i = 0; i < quantity; i++)
    {
        uint16_t value = (rx_buffer[7 + i*2] << 8) | rx_buffer[8 + i*2];
        holding_registers[start_address + i] = value;
    }

    // 构建响应
    modbus_tx_buffer[0] = 1;  // 从站地址
    modbus_tx_buffer[1] = 0x10;  // 功能码
    modbus_tx_buffer[2] = rx_buffer[2];  // 起始地址高
    modbus_tx_buffer[3] = rx_buffer[3];  // 起始地址低
    modbus_tx_buffer[4] = rx_buffer[4];  // 数量高
    modbus_tx_buffer[5] = rx_buffer[5];  // 数量低

    Modbus_Send_Response(modbus_tx_buffer, 6);
}

// 处理异常响应
void Modbus_Error_Response(uint8_t function_code, uint8_t exception_code)
{
    modbus_tx_buffer[0] = 1;  // 从站地址
    modbus_tx_buffer[1] = function_code | 0x80;  // 异常功能码
    modbus_tx_buffer[2] = exception_code;  // 异常代码

    Modbus_Send_Response(modbus_tx_buffer, 3);
}

// Modbus请求处理主函数
void Modbus_Process_Request(uint8_t *rx_buffer, uint16_t rx_length,
                          uint16_t *input_registers, uint16_t *holding_registers)
{
    uint8_t function_code = rx_buffer[1];

    switch(function_code)
    {
        case MODBUS_FUNC_READ_INPUT:  // 0x04
            Modbus_Read_Input_Registers(rx_buffer, input_registers);
            break;

        case MODBUS_FUNC_READ_HOLDING:  // 0x03
            Modbus_Read_Holding_Registers(rx_buffer, holding_registers);
            break;

        case MODBUS_FUNC_WRITE_SINGLE:  // 0x06
            Modbus_Write_Single_Register(rx_buffer, holding_registers);
            break;

        case MODBUS_FUNC_WRITE_MULTIPLE:  // 0x10
            Modbus_Write_Multiple_Registers(rx_buffer, holding_registers);
            break;

        default:
            // 不支持的功能码
            Modbus_Error_Response(function_code, 0x01);  // 非法功能码
            break;
    }
}